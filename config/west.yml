## config/west.yml
```yaml
manifest:
  defaults:
    revision: v0.3
  remotes:
    - name: zmkfirmware
      url-base: https://github.com/zmkfirmware
    - name: ssdorsey
      url-base: https://github.com/ssdorsey
  projects:
    - name: zmk
      remote: zmkfirmware
      import: app/west.yml
    - name: nice-view-mod
      remote: ssdorsey
      revision: main
  self:
    path: config
```
